## conf/layer.conf
```bitbake
# We have a conf and classes directory, add to BBPATH
BBPATH .= ":${LAYERDIR}"

# We have recipes-* directories, add to BBFILES
BBFILES += "${LAYERDIR}/recipes-*/*/*.bb \
            ${LAYERDIR}/recipes-*/*/*.bbappend"

BBFILE_COLLECTIONS += "meta-tangleid"
BBFILE_PATTERN_meta-tangleid = "^${LAYERDIR}/"
BBFILE_PRIORITY_meta-tangleid = "6"
```

## meta-dcurl/conf/layer.conf
```bitbake
# We have a conf and classes directory, add to BBPATH
BBPATH .= ":${LAYERDIR}"

# We have recipes-* directories, add to BBFILES
BBFILES += "${LAYERDIR}/recipes-*/*/*.bb \
            ${LAYERDIR}/recipes-*/*/*.bbappend"

BBFILE_COLLECTIONS += "dcurl"
BBFILE_PATTERN_dcurl = "^${LAYERDIR}/"
BBFILE_PRIORITY_dcurl = "6"

IMAGE_INSTALL_append = " dcurl"
```

## meta-tangleid-with-mender/conf/layer.conf
```bitbake
# We have a conf and classes directory, add to BBPATH
BBPATH .= ":${LAYERDIR}"

# We have recipes-* directories, add to BBFILES
BBFILES += "${LAYERDIR}/recipes-*/*/*.bb \
            ${LAYERDIR}/recipes-*/*/*.bbappend"

BBFILE_COLLECTIONS += "tangleid-with-mender"
BBFILE_PATTERN_tangleid-with-mender = "^${LAYERDIR}/"
BBFILE_PRIORITY_tangleid-with-mender = "6"

LAYERDEPENDS_tangleid-with-mender = "tangleid mender"
```

## meta-tangleid/conf/layer.conf
```bitbake
# We have a conf and classes directory, add to BBPATH
BBPATH .= ":${LAYERDIR}"

# We have recipes-* directories, add to BBFILES
BBFILES += "${LAYERDIR}/recipes-*/*/*.bb \
            ${LAYERDIR}/recipes-*/*/*.bbappend"

BBFILE_COLLECTIONS += "tangleid"
BBFILE_PATTERN_tangleid = "^${LAYERDIR}/"
BBFILE_PRIORITY_tangleid = "6"

IMAGE_INSTALL_append = " tangleid"
```
